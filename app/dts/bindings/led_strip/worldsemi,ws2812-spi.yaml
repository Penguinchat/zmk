## app/dts/bindings/led_strip/worldsemi,ws2812-spi.yaml
```yaml
description: ZMK Underglow remapping extension
compatible: "worldsemi,ws2812-spi"

properties:
  zmk,remapping:
    type: array
    required: false
    description: |
      Physical LED layout remapping indices. Should contain exactly 'chain-length'
      number of integers representing the physical position for each logical LED.
```

## app/dts/bindings/led_strip/zmk,underglow-remap.yaml
```yaml
# zmk,underglow-remap.yaml
description: ZMK Underglow remapping extension
compatible: "worldsemi,ws2812-spi"

properties:
  zmk,remapping:
    type: array
    required: false
    description: |
      Physical LED layout remapping indices. Should contain exactly 'chain-length'
      number of integers representing the physical position for each logical LED.
    constraint: |
      (len(this) == dt_node_array_len(../)) && all(e in this : e >= 0 && e < dt_node_array_len(../))
```
